## boards/shields/seeed_xiao_sx1262/Kconfig.shield
```kconfig
config SHIELD_SEEED_XIAO_SX1262
	def_bool $(shields_list_contains,seeed_xiao_sx1262)

config SHIELD_SEEED_B2B_SX1262
	def_bool $(shields_list_contains,seeed_b2b_sx1262)
```

## drivers/auxdisplay/Kconfig.ssd1803a
```kconfig
# Copyright (c) 2024 Dane Wagner <dane.wagner@gmail.com>
# SPDX-License-Identifier: Apache-2.0

config AUXDISPLAY_SSD1803A
	bool "SSD 1803A dot character VFD driver"
	default y
	select SPI
	depends on DT_HAS_SOLOMON_SSD1803A_ENABLED
	help
	  Enable driver for SSD 1803A.
```

## drivers/clock_control/Kconfig.sam0
```kconfig
# Copyright (c)
# SPDX-License-Identifier: Apache-2.0

config CLOCK_CONTROL_SAM0
	bool "Atmel SAM0 clock control"
	default y
	depends on DT_HAS_ATMEL_SAM0_GCLK_ENABLED
	help
	  Enable driver for Atmel SAM0 Clock Control.
```

## drivers/dac/Kconfig.stm32
```kconfig
# DAC configuration options

# Copyright (c) 2020 Libre Solar Technologies GmbH
#
# SPDX-License-Identifier: Apache-2.0

config DAC_STM32
	bool "STM32 DAC driver"
	default y
	depends on DT_HAS_ST_STM32_DAC_ENABLED
	select PINCTRL
	help
	  Enable the driver implementation for the stm32xx DAC

if DAC_STM32

config DAC_STM32_DMA
	bool "STM32 MCU DAC DMA Support"
	select DMA
	help
	  Enable the DAC DMA mode for DAC instances
	  that enable dma channels in their device tree node.

if DAC_STM32
config DAC_STM32_DMA_MAX_BLOCKS
	int "Maximum number of buffers"
	default 4
	help
		The maximum number of buffers usable by the DAC DMA.
endif

endif
```

## dts/bindings/auxdisplay/solomon,ssd1803a.yaml
```yaml
# Copyright (c) 2023 Chen Xingyu <hi@xingrz.me>
# SPDX-License-Identifier: Apache-2.0

description: Solomon Systech SSD1803A Dot Character VFD Controller/Driver IC

compatible: "solomon,ssd1803a"

include: [auxdisplay-device.yaml, spi-device.yaml]

properties:
  cursor:
    type: boolean
    description: Highlight active cursor.

  blink:
    type: boolean
    description: Blink character at cursor position.

  brightness:
    default: 127
    type: int
    description: Default brightness.

  invert:
    type: boolean
    description: Invert display (white on black).

  invert-cursor:
    type: boolean
    description: Invert character at cursor position.

  enable-segram:
    type: boolean
    description: Enable segment RAM.

  disable-boost:
    type: boolean
    description: Disable voltage boost and regulator.

  cgrom-size:
    type: int
    enum:
      - 256
      - 250
      - 248
      - 240
    default: 256
    description: The mapped size of the CGROM. Remaining character indexes are used for custom characters.

  character-set:
    type: int
    enum:
      - 0
      - 1
      - 2
    default: 0
    description: Which CGROM to use.

  reset-gpios:
    type: phandle-array
    description: Reset pin.

  mode-gpios:
    type: phandle-array
    description: SPI/I2C mode pin.

  columns:
    enum:
      - 16
      - 20
      - 32
      - 40
      - 64
      - 80

  rows:
    enum:
      - 1
      - 2
      - 3
      - 4
```

## dts/bindings/flash_controller/atmel,sam0-nvmctrl.yaml
```yaml
description: Atmel SAM0 NVMC (Non-Volatile Memory Controller)

compatible: "atmel,sam0-nvmctrl"

include:
  - name: flash-controller.yaml
  - name: atmel,assigned-clocks.yaml

properties:
  lock-regions:
    type: int
    required: true
    description: Number of lock regions
```

## dts/bindings/interrupt-controller/atmel,sam0-eic.yaml
```yaml
description: Atmel SAM0 series External Interrupt Controller

compatible: "atmel,sam0-eic"

include:
  - name: base.yaml
  - name: atmel,assigned-clocks.yaml

properties:
  reg:
    required: true

  interrupts:
    required: true
```

## dts/bindings/misc/st,stm32-cordic.yaml
```yaml
description: STM32 CORDIC Accelerator Module

compatible: "st,stm32-cordic"

include:
  - name: base.yaml
  - name: reset-device.yaml

properties:
  reg:
    required: true

  clocks:
    required: true

  resets:
    required: true

  interrupts:
    required: true
```

## dts/bindings/misc/st,stm32-dfsdm.yaml
```yaml
description: STM32 Sigma Delta Digital Filter Module

compatible: "st,stm32-dfsdm"

include:
  - name: base.yaml
  - name: reset-device.yaml

properties:
  reg:
    required: true

  clocks:
    required: true

  resets:
    required: true

  interrupts:
    required: true

  sinc_order:
    type: int
    description: The order of the Sinc filter used. Can be 0 for FastSinc,
      1 for first-order, up to 5 for 5th-order Sinc.

  intg_oversample:
    type: int
    description: The amount of decimation performed in the integrator stage
      minus one. Set to 1 to disable the integrator decimation.

  sinc_oversample:
    type: int
    description: The amount of decimation performed in the filter stage
      minus one. Set to 1 to disable the filter decimation.
```

## dts/bindings/misc/st,stm32-fmac.yaml
```yaml
description: STM32 Digital Filter Accelerator Module

compatible: "st,stm32-fmac"

include:
  - name: base.yaml
  - name: reset-device.yaml

properties:
  reg:
    required: true

  clocks:
    required: true

  resets:
    required: true

  interrupts:
    required: true
  
  operation:
    type: string
    enum:
      - "convolution"
      - "iir"
    default: "convolution"
    description: Selects the type of operation performed by the FMAC. When configuring
      the FMAC for FIR, select "convolution".

  feedback_coeffs:
    type: int
    default: 0
    description: The number of feedback coefficients for an IIR filter. Only meaningful
      if `operation` is set to "iir".

  x1_wm:
    type: int
    enum:
      - 1
      - 2
      - 4
      - 8
    default: 2
    description: Watermark for X1 buffer in samples.

  y_wm:
    type: int
    enum:
      - 1
      - 2
      - 4
      - 8
    default: 2
    description: Watermark for Y buffer in samples.

  x1_size:
    type: int
    default: 4
    description: Entries allocated for X1 buffer.

  x2_size:
    type: int
    default: 248
    description: Entries allocated for X2 buffer.
    
  y_size:
    type: int
    default: 4
    description: Entries allocated for Y buffer.

  lshift:
    type: int
    default: 0
    description: Left-shift applied to output data.

  clip:
    type: boolean
    description: Enable clipping (saturation on output).
```

## dts/bindings/misc/st,stm32-opamp.yaml
```yaml
description: STM32 On-board OPAMP

compatible: "st,stm32-opamp"

include:
  - name: base.yaml
  - name: pinctrl-device.yaml

properties:
  reg:
    required: true

  clocks:
    required: true

  pos-term:
    type: int
    required: true

  neg-term:
    type: int
    required: true
```

## dts/bindings/watchdog/atmel,sam0-watchdog.yaml
```yaml
description: Atmel SAM0 watchdog

compatible: "atmel,sam0-watchdog"

include:
  - name: base.yaml
  - name: atmel,assigned-clocks.yaml

properties:
  reg:
    required: true

  interrupts:
    required: true
```

## modules/loramac-node/Kconfig
```kconfig
#
# Copyright (c) 2019 Manivannan Sadhasivam
#
# SPDX-License-Identifier: Apache-2.0
#

config ZEPHYR_LORAMAC_NODE_MODULE
	bool

config HAS_SEMTECH_RADIO_DRIVERS
	bool "Semtech LoRa Radio Drivers"
	help
	  This option enables the use of Semtech's Radio drivers

config HAS_SEMTECH_SX1272
	bool
	select HAS_SEMTECH_RADIO_DRIVERS

config HAS_SEMTECH_SX1276
	bool
	select HAS_SEMTECH_RADIO_DRIVERS

config HAS_SEMTECH_SX126X
	bool
	select HAS_SEMTECH_RADIO_DRIVERS

config HAS_SEMTECH_LORAMAC
	bool "Semtech LoRaMac Stack"
	depends on HAS_SEMTECH_RADIO_DRIVERS
	help
	  This option enables the use of Semtech's LoRaMac stack

config HAS_SEMTECH_SOFT_SE
	bool "Semtech Secure Element software implementation"
	depends on HAS_SEMTECH_LORAMAC
	help
	  This option enables the use of Semtech's Secure Element
	  software implementation

config LORAMAC_SECURE_ELEMENT_PRE_PROVISIONED
	bool "Secure Element pre-provisioned"
	depends on HAS_SEMTECH_LORAMAC
	help
	  This option disables auto-provisioning of the secure element
	  used by LoRaMAC.

config LORAMAC_CLASSB_ENABLED
	bool "Enable Class B support"
	depends on HAS_SEMTECH_LORAMAC
```
